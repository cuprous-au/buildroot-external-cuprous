// SPDX-License-Identifier: (GPL-2.0+ OR MIT)
/*
 * raspberrypi5_cuprous_gw.dts - Device Tree file for the RPI5 Cuprous Gateway
 *
 * Copyright (C) 2025 Cuprous Pty Ltd
 */
// Cuprous board specific declarations
/dts-v1/;
/plugin/;
#include <dt-bindings/gpio/gpio.h>

/ {
	compatible = "brcm,bcm2712";

	fragment@0 {
		target = <&leds>;
		__overlay__ {
			access-point {
				label = "AP";
				gpios = <&gpio 23 GPIO_ACTIVE_HIGH>;
			};
		};
	};
};

